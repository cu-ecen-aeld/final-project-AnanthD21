## base_external/Config.in
```kconfig
source "$BR2_EXTERNAL_assignment_base_PATH/package/aesd-assignments/Config.in"
source "$BR2_EXTERNAL_assignment_base_PATH/package/aesd-hello-world/Config.in"
source "$BR2_EXTERNAL_assignment_base_PATH/package/aesd-server-client-test/Config.in"
source "$BR2_EXTERNAL_assignment_base_PATH/package/aesd-temp-sensor/Config.in"
source "$BR2_EXTERNAL_assignment_base_PATH/package/aesd-lcd-test/Config.in"
```

## base_external/package/aesd-hello-world/Config.in
```kconfig
config BR2_PACKAGE_AESD_HELLO_WORLD
	bool "aesd-hello-world"
	help
	  Simple helloworld to understand flow till target (raspberry pi)
```

## base_external/package/aesd-lcd-test/Config.in
```kconfig
config BR2_PACKAGE_AESD_LCD_TEST
        bool "aesd-lcd-test"
        help
          code to check the working of LCD
```

## base_external/package/aesd-server-client-test/Config.in
```kconfig
config BR2_PACKAGE_AESD_SERVER_CLIENT_TEST
        bool "aesd-server-client-test"
        help
          server client code
```

## base_external/package/aesd-temp-sensor/Config.in
```kconfig
config BR2_PACKAGE_AESD_TEMP_SENSOR
        bool "aesd-temp-sensor"
        help
          code to read temperature sensor values from MLX90614
```
